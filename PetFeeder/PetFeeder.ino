#include <WiFi.h>
#include <WiFiClientSecure.h>
#include <ESP32Servo.h>
#include <UniversalTelegramBot.h>
#include <ArduinoJson.h>
#include <time.h>

Servo myservo;

// Servo output
static const int servoPin = 13;

/////////////////////////////////////////////////////////////////////////////////////////////////////////////////////////////
//                                                        WIFI INFO                                                        //
/////////////////////////////////////////////////////////////////////////////////////////////////////////////////////////////

const char* ssid     = "CasaFeliz";
const char* password = "hermes77";

/////////////////////////////////////////////////////////////////////////////////////////////////////////////////////////////
//                                                  TELEGRAM BOT INFO                                                      //
/////////////////////////////////////////////////////////////////////////////////////////////////////////////////////////////

#define BOTtoken "7418097075:AAEw1JGMieR3sHj9FPJmhgEkFRXR16D9x2Y"

#define CHAT_ID "7687450502"

/////////////////////////////////////////////////////////////////////////////////////////////////////////////////////////////
//                                             TELEGRAM BOT INITIALIZER                                                    //
/////////////////////////////////////////////////////////////////////////////////////////////////////////////////////////////

WiFiClientSecure client;
UniversalTelegramBot bot(BOTtoken, client);

/////////////////////////////////////////////////////////////////////////////////////////////////////////////////////////////
//                                                    COMMANDS LIST                                                        //
/////////////////////////////////////////////////////////////////////////////////////////////////////////////////////////////

String msgCommands = "Commands:\n/feed \n/scheduleTime";

/////////////////////////////////////////////////////////////////////////////////////////////////////////////////////////////
//                                                   SCHEDULE VARIABLES                                                    //
/////////////////////////////////////////////////////////////////////////////////////////////////////////////////////////////

// (-1 = no schedule)
int scheduledHour = -1;
int scheduledMinute = -1;

/////////////////////////////////////////////////////////////////////////////////////////////////////////////////////////////
/////////////////////////////////////////////////////////////////////////////////////////////////////////////////////////////
//                                             TELEGRAM BOT MESSAGE HANDLER                                               //
/////////////////////////////////////////////////////////////////////////////////////////////////////////////////////////////
/////////////////////////////////////////////////////////////////////////////////////////////////////////////////////////////

void handleNewMessages(int numNewMessages) 
{

/////////////////////////////////////////////////////////////////////////////////////////////////////////////////////////////
//                                                    CHECK CHAT ID                                                        //
/////////////////////////////////////////////////////////////////////////////////////////////////////////////////////////////

  for (int i = 0; i < numNewMessages; i++) 
  {
    String chat_id = String(bot.messages[i].chat_id);
    if (chat_id != CHAT_ID) {
      bot.sendMessage(chat_id, "Unauthorized user", "");
      continue;
    }

    String text = bot.messages[i].text;

/////////////////////////////////////////////////////////////////////////////////////////////////////////////////////////////
//                                               CHECK IF ANYTHING WAS TYPED                                               //
/////////////////////////////////////////////////////////////////////////////////////////////////////////////////////////////
    
    if (text.isEmpty()) 
    {
      bot.sendMessage(chat_id, "You didn’t type a command. Please enter a valid command.\n" + msgCommands, "");
    }

/////////////////////////////////////////////////////////////////////////////////////////////////////////////////////////////
//                                                   COMMAND /feed                                                         //
///////////////////////////////////////////////////////////////////////////////////////////////////////////////////////////// 

    else if (text == "/feed") 
    {
      bot.sendMessage(chat_id, "Feeding...", "");
      myservo.write(180);
      delay(5000);
      myservo.write(0);
      bot.sendMessage(chat_id, "Successfully fed!", "");
      bot.sendMessage(chat_id, msgCommands, "");
    }

/////////////////////////////////////////////////////////////////////////////////////////////////////////////////////////////
//                                                COMMAND /scheduleTime                                                    //
///////////////////////////////////////////////////////////////////////////////////////////////////////////////////////////// 

    else if (text == "/scheduleTime") 
    {
      bot.sendMessage(chat_id, "Please send the time in HH:MM format", "");
    } 

    // Validating the sent time format
    else if (text.indexOf(':') != -1 && scheduledHour == -1 && scheduledMinute == -1)
    {
      // Processing hh:mm
      int colonIndex = text.indexOf(':');
      String hourString = text.substring(0, colonIndex);
      String minuteString = text.substring(colonIndex + 1);

      // Convert values -> int 
      int hour = hourString.toInt();
      int minute = minuteString.toInt();

      // Validating the sent time
      if (hour >= 0 && hour < 24 && minute >= 0 && minute < 60)
      {
        // Store the hour
        scheduledHour = hour;

        // Store the minute
        scheduledMinute = minute;

        // Feedback message confirming the schedule
        bot.sendMessage(chat_id, "Time scheduled for " + hourString + ":" + minuteString, "");
      } 
      else 
      {
        // Feedback message if the time is invalid
        bot.sendMessage(chat_id, "Invalid time. Please use the HH:MM format (e.g., 14:30)", "");
      }
    }

/////////////////////////////////////////////////////////////////////////////////////////////////////////////////////////////
//                             FEEDBACK MESSAGE IF SOMETHING NON-COMMAND IS TYPED                                          //
/////////////////////////////////////////////////////////////////////////////////////////////////////////////////////////////

    else 
    {
      bot.sendMessage(chat_id, "Unrecognized command. Please try again.\n" + msgCommands, "");
    }
  }
}

/////////////////////////////////////////////////////////////////////////////////////////////////////////////////////////////
/////////////////////////////////////////////////////////////////////////////////////////////////////////////////////////////
//                                                SCHEDULE HANDLING FUNCTION                                              //
/////////////////////////////////////////////////////////////////////////////////////////////////////////////////////////////
/////////////////////////////////////////////////////////////////////////////////////////////////////////////////////////////

void checkScheduledTime() 
{
  // Unix time
  time_t now = time(nullptr);

  // Unix -> readable time
  struct tm* timeInfo = localtime(&now);
  int currentHour = timeInfo->tm_hour;
  int currentMinute = timeInfo->tm_min;

/////////////////////////////////////////////////////////////////////////////////////////////////////////////////////////////
//                                          SERVO MOTOR OPERATION EXECUTION                                                //
/////////////////////////////////////////////////////////////////////////////////////////////////////////////////////////////

  if (scheduledHour == currentHour && scheduledMinute == currentMinute) 
  {
    bot.sendMessage(CHAT_ID, "Scheduled time reached. Feeding...", "");
    myservo.write(90);
    delay(500);
    myservo.write(0);
    bot.sendMessage(CHAT_ID, "Successfully fed!", "");

/////////////////////////////////////////////////////////////////////////////////////////////////////////////////////////////
//                                          RESETTING SCHEDULE AFTER EXECUTION                                             //
/////////////////////////////////////////////////////////////////////////////////////////////////////////////////////////////

    // Prevent looping during the same hh:mm
    scheduledHour = -1; 
    scheduledMinute = -1;

    bot.sendMessage(CHAT_ID, msgCommands, "");
  }
}

/////////////////////////////////////////////////////////////////////////////////////////////////////////////////////////////
/////////////////////////////////////////////////////////////////////////////////////////////////////////////////////////////
//                                                     SETUP FUNCTION                                                     //
/////////////////////////////////////////////////////////////////////////////////////////////////////////////////////////////
/////////////////////////////////////////////////////////////////////////////////////////////////////////////////////////////

void setup() 
{
  Serial.begin(115200);

  // Attach the servo to the servoPin
  myservo.attach(servoPin);

/////////////////////////////////////////////////////////////////////////////////////////////////////////////////////////////
//                                                 WIFI CONFIGURATION                                                      //
/////////////////////////////////////////////////////////////////////////////////////////////////////////////////////////////

  Serial.print("Connecting to ");
  Serial.println(ssid);
  WiFi.begin(ssid, password);
  client.setCACert(TELEGRAM_CERTIFICATE_ROOT);

  while (WiFi.status() != WL_CONNECTED) 
  {
    delay(500);
    Serial.print(".");
  }

/////////////////////////////////////////////////////////////////////////////////////////////////////////////////////////////
//                                                TIMEZONE CONFIGURATION                                                   //
/////////////////////////////////////////////////////////////////////////////////////////////////////////////////////////////

  // Brazil (-3)
  configTime(-3 * 3600, 0, "pool.ntp.org", "time.nist.gov");

/////////////////////////////////////////////////////////////////////////////////////////////////////////////////////////////
//                                               FEEDBACK MESSAGES                                                         //
/////////////////////////////////////////////////////////////////////////////////////////////////////////////////////////////

  Serial.println("");
  Serial.println("WiFi connected.");
  Serial.println("IP address: ");
  Serial.println(WiFi.localIP());

  bot.sendMessage(CHAT_ID, "Bot started", "");
  bot.sendMessage(CHAT_ID, msgCommands, "");
}

/////////////////////////////////////////////////////////////////////////////////////////////////////////////////////////////
/////////////////////////////////////////////////////////////////////////////////////////////////////////////////////////////
//                                                     LOOP FUNCTION                                                      //
/////////////////////////////////////////////////////////////////////////////////////////////////////////////////////////////
/////////////////////////////////////////////////////////////////////////////////////////////////////////////////////////////

void loop() 
{
  int numNewMessages = bot.getUpdates(bot.last_message_received + 1);
  while (numNewMessages) 
  {
    handleNewMessages(numNewMessages);
    numNewMessages = bot.getUpdates(bot.last_message_received + 1);
  }
  checkScheduledTime();
}
